/*
 * Copyright 2021 Dennis Ruffer <daruffer@gmail.com>
 * SPDX-License-Identifier: Apache-2.0
 */

#include "test_common.dtsi"

/ {
	regulator {
		enable-gpios = <&gpiok 0 GPIO_ACTIVE_HIGH>;
	};
	resources {
		check-gpios = <&gpiok 1 (GPIO_ACTIVE_HIGH | GPIO_PULL_DOWN)>;
	};
};
