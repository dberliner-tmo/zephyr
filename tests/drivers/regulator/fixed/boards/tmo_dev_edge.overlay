/*
 * Copyright (c) 2021 T-Mobile USA, Inc.
 *
 * SPDX-License-Identifier: Apache-2.0
 */

#include "test_common.dtsi"

/ {
	regulator {
		enable-gpios = <&gpiok 0 GPIO_ACTIVE_HIGH>;
	};
	resources {
		check-gpios = <&gpiok 1 (GPIO_ACTIVE_HIGH | GPIO_PULL_DOWN)>;
	};
};
