## boards/arm/pets_v2_dev_kit/Kconfig.board
```kconfig
# T-Mobile Pets V2 Development Board

# Copyright (c) 2018, Christian Taedcke
# Copyright (c) 2019  Lemonbeat GmbH
# SPDX-License-Identifier: Apache-2.0

config BOARD_PETS_V2_DEV_KIT
	bool "T-Mobile Pets V2 Development Kit"
	depends on SOC_SERIES_EFM32PG12B
	select SOC_PART_NUMBER_EFM32PG12B500F1024GL125
```

## boards/arm/pets_v2_dev_kit/Kconfig.defconfig
```kconfig
# EFM32PG STK3402A board

# Copyright (c) 2018, Christian Taedcke
# Copyright (c) 2019  Lemonbeat GmbH
# SPDX-License-Identifier: Apache-2.0

if BOARD_PETS_V2_DEV_KIT

config BOARD
	default "pets_v2_dev_kit"

config CMU_HFXO_FREQ
	default 40000000

config CMU_LFXO_FREQ
	default 32768

config COUNTER_GECKO_RTCC
	default y
	depends on COUNTER

endif
```

## boards/arm/pets_v2_dev_kit/dts/bindings/murata,1sc.yaml
```yaml
description: murata 1sc modem

compatible: "murata,1sc"

include: uart-device.yaml

properties:
    label:
      required: true

    mdm-wake-host-gpios:
      type: phandle-array
      required: true

    mdm-wake-mdm-gpios:
      type: phandle-array
      required: true

    mdm-reset-gpios:
      type: phandle-array
      required: true
```

## boards/arm/pets_v2_dev_kit/dts/bindings/redpinesignals,rs9116w.yaml
```yaml
# A high level description of the device the binding applies to:
description: This is the RS9116W Combonation WiFi and bluetooth controller

compatible: "redpinesignals,rs9116w"

include: "spi-device.yaml"

properties:
  int-gpios:
      type: phandle-array
      required: true

  reset-gpios:
    type: phandle-array
    required: false

  sleep-gpios:
    type: phandle-array
    required: false

  wake-gpios:
    type: phandle-array
    required: false
 
  wakeo-gpios:
    type: phandle-array
    required: false
 
  poc-gpios:
    type: phandle-array
    required: false
 
```

## drivers/modem/Kconfig.murata_1sc
```kconfig
# Murata 1SC driver options

# Copyright (c) 2022 T-Moblie
# SPDX-License-Identifier: Apache-2.0

menuconfig MODEM_MURATA_1SC
        bool "Enable murata-1sc modem driver"
        select MODEM_CONTEXT
        select MODEM_CMD_HANDLER
        select MODEM_IFACE_UART
        select MODEM_SOCKET
        select NET_SOCKETS_OFFLOAD
        imply GPIO
        help
          Choose this setting to enable Murata 1SC modem
          driver.

if MODEM_MURATA_1SC
config MODEM_MURATA_1SC_RX_STACK_SIZE
        int "Stack size for the MURATA_1SC modem driver RX thread"
        default 1028
        help
          This stack is used by the MURATA_1SC RX thread.

config MODEM_MURATA_1SC_RX_WORKQ_STACK_SIZE
        int "Stack size for the MURATA_1SC modem driver work queue"
        default 2048
        help
          This stack is used by the work queue to pass off net_pkt data
          to the rest of the network stack, letting the rx thread continue
          processing data.

config MODEM_MURATA_1SC_APN
        string "APN for establishing network connection"
        default "internet"
        help
          This setting is used to set the APN name for the network connection
          context.  This value is specific to the network provider and may
          need to be changed.

config MODEM_MURATA_1SC_USERNAME
        string "Username for establishing network connection"
        default ""
        help
          This setting is used to set the User name for the network connection
          context.  This value is specific to the network provider and may
          need to be changed.

config MODEM_MURATA_1SC_PASSWORD
        string "Password for establishing network connection"
        default ""
        help
          This setting is used to set the Password for the network connection
          context.  This value is specific to the network provider and may
          need to be changed.

config MODEM_MURATA_1SC_INIT_PRIORITY
        int "MURATA_1SC driver init priority"
        default 80
        help
          MURATA_1SC device driver initialization priority.
          Do not mess with it unless you know what you are doing.
          Note that the priority needs to be lower than the net stack
          so that it can start before the networking sub-system.
config AMAZON_CA_ROOT_SLOT
        int "Amazon Root CA slot"
        default 10
        help
         This is cert profile ID for Amazon Root CA.
config SNI_SLOT
        int "customer server's CA slot"
        default 8
        help
         This is cert profile ID for customer server that requires SNI extension.
         
config TLS_SNI_HOSTNAME
        string "URI for customer server"
        default "echo.hagen.tech"
        help
         This is URI for customer server that requires SNI extension.
         
config MODEM_DEMO_LOW_POWERMODE
        bool "Yes or No for Demo Modem Low Power"
        help
          This is to demo that Modem stay in inactive mode for low power usage
endif  #MODEM_MURATA_1SC
```

## drivers/sensor/tmp108/zephyr/Kconfig
```kconfig
# TMP108 temperature sensor configuration options

# Copyright (c) 2019 Centaur Analytics, Inc
# SPDX-License-Identifier: Apache-2.0

config TMP108
	bool "TMP108 Temperature Sensor"
	depends on I2C
	select SENSOR
	help
	  Enable driver for TMP108 temperature sensor.
```

## drivers/wifi/rs9116w/Kconfig.rs9116w
```kconfig
# RS9116W WiFi driver options

# Copyright (c) 2022 T-Mobile USA, Inc.
# SPDX-License-Identifier: Apache-2.0

config WIFI_RS9116W
	bool "RS9116W WiFi driver support"
	select WISECONNECT
	select WISECONNECT_WIFI
	select NET_L2_WIFI_MGMT
	select WIFI_OFFLOAD
	select NET_OFFLOAD
	select NET_SOCKETS
	imply NET_SOCKETS_OFFLOAD
	help
	  Enables WiFi support for the Redpine Signals RS9116W combined
	  WiFi Bluetooth module utilizing the the WiSeConnect SAPI

if WIFI_RS9116W

config RSI_WIFI_DEBUG
	bool "WiFi driver debug"
	default y
	help
	  WiFi driver debug

endif # WIFI_RS9116W

if NET_SOCKETS_OFFLOAD && NET_SOCKETS_SOCKOPT_TLS

config RSI_NEED_BAS64
	bool
	default y
	select BASE64

endif
```

## drivers/wifi/rs9116w/zephyr/Kconfig.rs9116w
```kconfig
config WIFI_RS9116W
    bool "RS9116W WiFi driver support"
    select HAS_RS9116W
    select POLL
    help
      Enables WiFi support for the Redpine Signals RS9116W combined
      WiFi Bluetooth module utilizing the the WiSeConnect SAPI

if WIFI_RS9116W

config WIFI_RS9116W_NAME
    string "Driver name"
    default "RS9116W"

choice WIFI_RS9116W_BUS
    bool "Select BUS interface"
	  default WIFI_RS9116W_BUS_SPI

config WIFI_RS9116W_BUS_SPI
    bool "SPI interface"
    select RS9116W_BUS_SPI
    depends on SPI
    select SENSOR
    help
      Uses the SPI interface to communicate to the RS9116W Module

config WIFI_RS9116W_BUS_UART
    bool "UART interface"
    select RS9116W_BUS_UART
    depends on SERIAL
    help
      Uses the UART interface to communicate to the RS9116W Module

endchoice # WIFI_RS9116W_BUS

config RSI_WIFI_DEBUG
    bool "WiFi driver debug"
    default y
	help
	  This option enables debug support for the RS9116W
	  WiFi driver

endif # WIFI_RS9116W

if NET_SOCKETS_OFFLOAD && NET_SOCKETS_SOCKOPT_TLS

config RSI_NEED_BAS64
  bool
  default y
  select BASE64

endif
```

## dts/bindings/sensor/st,lps22hb-press.yaml
```yaml
# Copyright (c) 2017, Linaro Limited
# Copyright (c) 2022 T-Mobile USA, Inc.
#
# SPDX-License-Identifier: Apache-2.0

description: STMicroelectronics LPS22HB pressure sensor

compatible: "st,lps22hb-press"

include: i2c-device.yaml

properties:

    irq-gpios:
      type: phandle-array
      required: false
```
